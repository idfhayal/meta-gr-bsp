## conf/layer.conf
```bitbake
# We have a conf and classes directory, add to BBPATH
BBPATH .= ":${LAYERDIR}"

# We have recipes-* directories, add to BBFILES
BBFILES += "${LAYERDIR}/recipes-*/*/*.bb \
	${LAYERDIR}/recipes-*/*/*.bbappend"

BBFILE_COLLECTIONS += "gr-bsp"
BBFILE_PATTERN_gr-bsp = "^${LAYERDIR}/"
BBFILE_PRIORITY_gr-bsp = "6"

# Dependencies
LAYERDEPENDS_gr-bsp = "meta-altera"
LAYERVERSION_gr-bsp = "1"

# Altera SoC configuration
MACHINE = "gr-soc"

BBDEBUG = "yes"
```

## conf/machine/gr-soc.conf
```bitbake
#@TYPE: Machine
#@NAME: gr-soc
#@DESCRIPTION: Machine configuration for the GR Cyclone V SoC"

require conf/machine/cyclone5.conf

# SYS_BOARD
UBOOT_CONFIG = "gr-soc"

# SYS_CONFIG_NAME
UBOOT_CONFIG[gr-soc] = "socfpga_gr_soc_defconfig"
SPL_BINARY_gr-soc ="u-boot-with-spl.sfp"
PREFERRED_VERSION_u-boot-socfpga = "v2017.09%"

PREFERRED_PROVIDER_virtual/kernel = "linux-altera-ltsi"
PREFERRED_VERSION_linux-altera-ltsi = "4.9%"
GCCVERSION = "linaro-5.2"
SDKGCCVERSION = "linaro-5.2"
DEFAULTTUNE = "cortexa9hf-neon"

KMACHINE = "gr-soc"
KERNEL_DEVICETREE = "socfpga_cyclone5_de0_sockit.dtb"
UBOOT_EXTLINUX = "1"
UBOOT_EXTLINUX_FDTDIR_default = "../"
UBOOT_EXTLINUX_FDT_default = "../socfpga_cyclone5_de0_sockit.dtb"
UBOOT_EXTLINUX_FDT = "../socfpga_cyclone5_de0_sockit.dtb"

IMAGE_FSTYPES +="wic"
```
